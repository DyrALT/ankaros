## external/Config.in
```kconfig
source "$BR2_EXTERNAL_ANKAROS_PATH/package/ankaros-shell/Config.in"
source "$BR2_EXTERNAL_ANKAROS_PATH/package/ankaros-compositor/Config.in"
```

## external/package/ankaros-compositor/Config.in
```kconfig
config BR2_PACKAGE_ANKAROS_COMPOSITOR
	bool "ankaros-compositor"
	depends on BR2_PACKAGE_QT6
	depends on BR2_PACKAGE_QT6_GL_SUPPORTS
	select BR2_PACKAGE_ANKAROS_SHELL
	select BR2_PACKAGE_LIBXKBCOMMON
	select BR2_PACKAGE_QT6WAYLAND
	select BR2_PACKAGE_QT6WAYLAND_COMPOSITOR
	help
	  ankaros'un Wayland compositor'ı: tam ekran masaüstü
	  (Ankaros.Shell) ve pencere yönetimi.

comment "ankaros-compositor needs Qt 6 with OpenGL support"
	depends on !BR2_PACKAGE_QT6 || !BR2_PACKAGE_QT6_GL_SUPPORTS
```

## external/package/ankaros-shell/Config.in
```kconfig
config BR2_PACKAGE_ANKAROS_SHELL
	bool "ankaros-shell"
	depends on BR2_PACKAGE_QT6
	depends on BR2_PACKAGE_QT6_GL_SUPPORTS
	select BR2_PACKAGE_QT6BASE_GUI
	select BR2_PACKAGE_QT6BASE_OPENGL
	select BR2_PACKAGE_QT6DECLARATIVE
	select BR2_PACKAGE_QT6DECLARATIVE_QUICK
	select BR2_PACKAGE_QT6SHADERTOOLS
	help
	  ankaros masaüstü kabuğu (Ankaros.Shell QML modülü) ve onu
	  tam ekran gösteren önizleme uygulaması
	  (ankaros-shell-preview). Faz 1'de compositor gelene kadar
	  grafik yığınının test uygulaması olarak kullanılır.

comment "ankaros-shell needs Qt 6 with OpenGL support"
	depends on !BR2_PACKAGE_QT6 || !BR2_PACKAGE_QT6_GL_SUPPORTS
```

## external/package/ankaros-system/Config.in
```kconfig
config BR2_PACKAGE_ANKAROS_SYSTEM
	bool "ankaros-system"
	depends on BR2_INSTALL_LIBSTDCPP
	depends on BR2_TOOLCHAIN_USES_GLIBC
	select BR2_PACKAGE_LIBXCRYPT # şifre doğrulama (crypt)
	select BR2_PACKAGE_E2FSPROGS # veri diski: mkfs.ext4, e2fsck (karar 0017)
	help
	  ankaros sistem servisleri: init sistemi (ankaros-init, PID 1),
	  oturum yöneticisi (ankaros-session), ankarosctl ve temel
	  servis dosyaları.

	  Init olarak kullanmak için: System configuration > Init system
	  > ankaros-init

comment "ankaros-system needs a glibc toolchain w/ C++"
	depends on !BR2_INSTALL_LIBSTDCPP || !BR2_TOOLCHAIN_USES_GLIBC
```

## external/package/libvterm/Config.in
```kconfig
config BR2_PACKAGE_LIBVTERM
	bool "libvterm"
	help
	  VT220/xterm terminal öykünücüsü kütüphanesi. Ekran durumunu
	  tutar, çizimi kullanan uygulama yapar (ankaros Terminal,
	  karar 0014).

	  https://www.leonerd.org.uk/code/libvterm/
```

## external/package/xwayland-satellite/Config.in
```kconfig
config BR2_PACKAGE_XWAYLAND_SATELLITE
	bool "xwayland-satellite"
	depends on BR2_PACKAGE_HOST_RUSTC_TARGET_ARCH_SUPPORTS
	depends on BR2_PACKAGE_XWAYLAND
	select BR2_PACKAGE_HOST_RUSTC
	select BR2_PACKAGE_LIBXCB
	select BR2_PACKAGE_XCB_UTIL_CURSOR
	help
	  Yalnızca X11 bilen uygulamaların pencerelerini sıradan
	  Wayland pencerelerine çevirir (rootless Xwayland). Compositor
	  X11 pencere yöneticisi olmak zorunda kalmaz (karar 0019,
	  docs/xwayland.md).

	  https://github.com/Supreeeme/xwayland-satellite

comment "xwayland-satellite needs xwayland"
	depends on BR2_PACKAGE_HOST_RUSTC_TARGET_ARCH_SUPPORTS
	depends on !BR2_PACKAGE_XWAYLAND
```
